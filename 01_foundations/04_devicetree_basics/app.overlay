#include <zephyr/dt-bindings/gpio/gpio.h>

/ {
    course_leds {
        compatible = "gpio-leds";

        course_led: led_0 {
            gpios = <&gpio0 18 GPIO_ACTIVE_HIGH>;
            label = "Course LED";
        };
    };

    aliases {
        course-led = &course_led;
    };
};
