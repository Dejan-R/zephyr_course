## CMakeLists.txt
```
cmake_minimum_required(VERSION 3.20.0)

find_package(Zephyr REQUIRED HINTS $ENV{ZEPHYR_BASE})

project(build_system)

target_sources(app PRIVATE src/main.c)

target_compile_definitions(app PRIVATE
    APP_VERSION=\"1.0\"
)
```

## prj.conf
```kconfig
CONFIG_CONSOLE=y
CONFIG_PRINTK=y
```

## src/main.c
```c
#include <zephyr/sys/printk.h>

#ifndef APP_VERSION
#define APP_VERSION "undefined"
#endif

int main(void)
{
    printk("Zephyr Build System\n");
    printk("Application version: %s\n", APP_VERSION);
    printk("Build completed successfully!\n");

    return 0;
}
```
