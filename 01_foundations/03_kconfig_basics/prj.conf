## CMakeLists.txt
```
cmake_minimum_required(VERSION 3.20.0)
find_package(Zephyr REQUIRED HINTS $ENV{ZEPHYR_BASE})
project(kconfig_basics)
target_sources(app PRIVATE src/main.c)
```

## Kconfig
```
mainmenu "Kconfig Basics"

menu "Course settings"

config COURSE_FEATURE
    bool "Enable course feature"
    default y
    help
      Enables the example application feature.

config COURSE_REPEAT_COUNT
    int "Repeat count"
    range 1 5
    default 3
    depends on COURSE_FEATURE
    help
      Controls the number of messages printed when the feature is enabled.

endmenu

source "Kconfig.zephyr"
```

## prj.conf
```kconfig
CONFIG_CONSOLE=y
CONFIG_PRINTK=y
CONFIG_COURSE_FEATURE=y
CONFIG_COURSE_REPEAT_COUNT=3
```

## src/main.c
```c
#include <zephyr/kernel.h>
#include <zephyr/sys/printk.h>

int main(void)
{
    printk("Kconfig Basics\n");

#if defined(CONFIG_COURSE_FEATURE)
    printk("Feature enabled: yes\n");

    for (int i = 1; i <= CONFIG_COURSE_REPEAT_COUNT; i++) {
        printk("Message: %d\n", i);
    }
#else
    printk("Feature enabled: no\n");
#endif

    return 0;
}
```
