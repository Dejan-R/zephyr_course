#include <zephyr/dt-bindings/gpio/gpio.h>

/ {
    aliases {
        led1 = &my_led;
    };

    leds {
        compatible = "gpio-leds";

        my_led: led_0 {
            gpios = <&gpio0 18 GPIO_ACTIVE_HIGH>;
            label = "LED0";
        };
    };
};
